## CMakeLists.txt
```
cmake_minimum_required(VERSION 3.20)

# We're targeting the micro:bit v2 (and only that one)
set(BOARD bbc_microbit_v2)

find_package(Zephyr REQUIRED HINTS $ENV{ZEPHYR_BASE})

project(
    blinky
    VERSION 0.1.0
    DESCRIPTION "A workspace blinky application based on Zephyr targeting the micro:bit."
    LANGUAGES ASM C CXX
)

target_sources(app PRIVATE src/main.cpp)
```

## prj.conf
```kconfig
# C++ support
# partly inspired by Zpp https://github.com/lowlander/zpp/blob/master/samples/hello_world/prj.conf
CONFIG_CPP=y
CONFIG_STD_CPP20=y
CONFIG_NEWLIB_LIBC=y
CONFIG_NEWLIB_LIBC_NANO=y
CONFIG_GLIBCXX_LIBCPP=y
# CONFIG_SPEED_OPTIMIZATIONS=y
# CONFIG_COMPILER_OPT="-Wall -Wextra -Werror -Wno-error=empty-body -Wno-error=unused-parameter -Wno-error=type-limits -Wno-error=missing-field-initializers -Wno-error=sign-compare -Wno-error=ignored-qualifiers -Wno-error=old-style-declaration -Wno-error=cast-function-type"

# enable GPIO
CONFIG_GPIO=y
```

## app.overlay
```dts
&gpio0 {
	status="okay";
	label="GPIO_0";
};
&gpio1 {
	status="okay";
	label="GPIO_1";
};
```

## src/main.cpp
```c
/*
 * Copyright (c) 2012-2014 Wind River Systems, Inc.
 *
 * SPDX-License-Identifier: Apache-2.0
 */

#include <stdio.h>

int main(void)
{
	printf("This is using cpp\n");
	printf("Hello World! %s\n", CONFIG_BOARD);
	return 0;
}
```
